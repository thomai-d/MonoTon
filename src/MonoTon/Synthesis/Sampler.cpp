#include "Sampler.h"
#include "../System/Macros.h"
#include "../Hardware/Seg7.h"

static const PROGMEM sample_t KickSamples[3979] = { -14, 26, -108, -99, -19, 53, 81, 66, 59, 26, 6, -32, -51,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 0, };

static const PROGMEM sample_t HatSamples[481] = { -15, -7, 8, -7, 34, 23, -6, 23, -19, -5, 19, -17, -30,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 0, };

static const PROGMEM sample_t SnareSamples[2707] = { -8, -3, 12, -1, -43, -48, -59, -95, -81, -89, -91, -90, -91,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 0, };

static const PROGMEM sample_t ShakerSamples[2741] = { 0, -1, 0, 0, -1, 0, 0, -1, -1, -1, -1, -1, -1,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 0, };

static const PROGMEM sample_t ClapSamples[4458] = { -1, -2, -2, -3, -1, 0, -1, -2, -1, 1, 1, 1, -1,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 -1, };

static const PROGMEM sample_t OpenHatSamples[2288] = { -1, -1, -1, -1, 0, 0, -1, -1, 0, 0, 0, -1, -1,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 0, };

Sampler::Sampler(uint8_t sample)
{
	switch (sample)
	{
	case 0:
		this->sampleAddr = KickSamples;
		this->sampleCount = sizeof(KickSamples);
		break;

	case 1:
		this->sampleAddr = HatSamples;
		this->sampleCount = sizeof(HatSamples);
		break;

	case 2:
		this->sampleAddr = SnareSamples;
		this->sampleCount = sizeof(SnareSamples);
		break;

	case 3:
		this->sampleAddr = ShakerSamples;
		this->sampleCount = sizeof(ShakerSamples);
		break;

	case 4:
		this->sampleAddr = ClapSamples;
		this->sampleCount = sizeof(ClapSamples);
		break;

	case 5:
		this->sampleAddr = OpenHatSamples;
		this->sampleCount = sizeof(OpenHatSamples);
		break;

	default:
		this->sampleAddr = 0;
		this->sampleCount = 0;
		break;
	}
}

sample_t Sampler::NextSample()
{
	if (this->currentSample == (uint16_t)-1)
		return 0;

	sample_t sample = FLASH_READ_BYTE(this->sampleAddr, this->currentSample);
	
	this->currentSample++;
	if (this->currentSample == this->sampleCount)
	{
		this->currentSample = (uint16_t)-1;
	}

	if (this->velocity == 63)
		return sample;
	else
		return sample * this->velocity / 64;
}

void Sampler::SetParameter(uint8_t parameter, uint8_t value)
{
	if (parameter == 1)
		this->velocity = value;
}

void Sampler::Trigger()
{
	if (this->sampleAddr != 0)
	{
		this->currentSample = 0;
	}
}

void Sampler::ControlTick()
{
}

uint32_t Sampler::GetDisplayValue(uint8_t param, uint8_t value)
{
	return MAKE_7SEG(DIGIT_DASH, DIGIT_DASH, DIGIT_DASH);
}
